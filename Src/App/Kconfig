## Src/App/Kconfig
```kconfig
menu "app config"
    choice
        prompt "CAN assessment stage"
        default CAN_ASSESSMENT_BASIC

        config CAN_ASSESSMENT_BASIC
            bool "Basic"
            select BSP_USE_CAN
            select EXTENSION_MOTOR

        config CAN_ASSESSMENT_ADVANCED
            bool "Advanced"
            select BSP_USE_CAN
            select EXTENSION_MOTOR
            select EXTENSION_IMU
    endchoice

    config CAN_BASIC_CURRENT_MA
        int "Basic current (mA)"
        depends on CAN_ASSESSMENT_BASIC
        range -1000 1000
        default 100
endmenu
```

## Src/Common/Extensions/Kconfig
```kconfig
menu "extension config"
    config EXTENSION_RC
    bool "remote control(DT7)"
    default n
    
    config EXTENSION_MOTOR
    bool "motor driver"
    default n

    config EXTENSION_IMU
    bool "imu"
    default n

endmenu
```

## Src/Common/Soc/Kconfig
```kconfig
menu "Soc config"
    choice
        prompt "Soc target choice"
        default TARGET_STM32F103C8TX

        config TARGET_STM32F103C8TX
        bool "STM32F103C8TX"
        source "Src/Common/Soc/stm32f103c8tx/Kconfig"

        config TARGET_STM32F407IGHX
        bool "STM32F407IGHX"
        source "Src/Common/Soc/stm32f407ighx/Kconfig"

    endchoice

    config HAL_INCLUDEaa
        string
        default '"Src/Common/Soc/stm32f103c8tx/hal/Drivers/STM32F1xx_HAL_Driver/Inc/stm32f1xx_hal.h"' if TARGET_STM32F103C8TX
        default '"Src/Common/Soc/stm32f407ighx/hal/Drivers/STM32F4xx_HAL_Driver/Inc/stm32f4xx_hal.h"' if TARGET_STM32F407IGHX

    config SOC_USE_CUSTOM
    bool "custom soc"
    default n

endmenu
```

## Src/Utils/Kconfig
```kconfig
menu "utils config"
    config USE_HARDFAULT 
        bool "segger hardfault handle"
        default y
    config USE_STM_LOG
        bool "stm log"
        default y
        
    source "Src/Utils/Log/Kconfig"

    config USE_SINGLETON
        bool "singleton class base"
        default y
endmenu
```

## can_advanced_defconfig
```kconfig
CONFIG_TARGET_MASTER=y
CONFIG_TARGET_STM32F407IGHX=y
CONFIG_CAN_ASSESSMENT_ADVANCED=y
CONFIG_RTOS_DEBUG=y
```

## can_basic_defconfig
```kconfig
CONFIG_TARGET_MASTER=y
CONFIG_TARGET_STM32F407IGHX=y
CONFIG_CAN_ASSESSMENT_BASIC=y
CONFIG_CAN_BASIC_CURRENT_MA=100
CONFIG_RTOS_DEBUG=y
```
